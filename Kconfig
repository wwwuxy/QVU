## Kconfig
```kconfig
mainmenu "Test File Config"

# 顶级选择，确保各个测试类型互斥
choice
    prompt "Test Type"
    default TYPE_RESNET

    config TYPE_RESNET
        bool "ResNet Tests"
        help
            Enable ResNet related tests

    config TYPE_VGG
        bool "VGG Tests"
        help
            Enable VGG related tests

    config TYPE_ALEXNET
        bool "AlexNet Tests"
        help
            Enable AlexNet related tests

    config TYPE_LENET
        bool "LeNet Tests"
        help
            Enable LeNet related tests
            
    config TYPE_MOBILENET
        bool "MobileNet Tests"
        help
            Enable MobileNet related tests
            
    config TYPE_SQUEEZENET
        bool "SqueezeNet Tests"
        help
            Enable SqueezeNet related tests
            
    config TYPE_CONVNEXT
        bool "ConvNeXt Tests"
        help
            Enable ConvNeXt related tests

    config TYPE_SHUFFLENETV2
        bool "ShuffleNetV2 Tests"
        help
            Enable ShuffleNetV2 related tests
            
    config TYPE_EFFICIENTNET
        bool "EfficientNet Tests"
        help
            Enable EfficientNet related tests

    config TYPE_REGNET
        bool "RegNet Tests"
        help
            Enable RegNet related tests

    config TYPE_SAMPLE
        bool "Sample Test"
        help
            Enable manually sample test
endchoice

# ResNet测试选项
menu "RESNET_TEST"
    visible if TYPE_RESNET
    
    choice
        prompt "Select operation type"
        default RESNET_INT8
        help
            Select one of the ResNet operations for the test.

    config RESNET_INT8
        bool "resnet_int8_test"

        help
            Enable Posit32 to Int8 truncation test.
    
    config RESNET_INT4
        bool "resnet_int4_test"

        help
            Enable Posit32 to Int4 truncation test.
    
    config RESNET_FP16
        bool "resnet_fp16_test"

        help
            Enable Posit32 to FP16 truncation test.
            
    config RESNET_FP8
        bool "resnet_fp8_test"

        help
            Enable Posit32 to FP8 truncation test.
            
    config RESNET_FP4
        bool "resnet_fp4_test"

        help
            Enable Posit32 to FP4 truncation test.

    endchoice
endmenu

# VGG测试菜单
menu "VGG_TEST"
    visible if TYPE_VGG
    
    choice
        prompt "Select operation type"
        default VGG_INT8
        help
            Select one of the VGG operations for the test.

    config VGG_INT8
        bool "vgg_int8_test"

        help
            Enable Posit32 to Int8 truncation test for VGG.
        
    config VGG_INT4
        bool "vgg_int4_test"

        help
            Enable Posit32 to Int4 truncation test for VGG.

    config VGG_FP16
        bool "vgg_fp16_test"

        help
            Enable Posit32 to FP16 truncation test for VGG.
            
    config VGG_FP8
        bool "vgg_fp8_test"

        help
            Enable Posit32 to FP8 truncation test for VGG.
            
    config VGG_FP4
        bool "vgg_fp4_test"

        help
            Enable Posit32 to FP4 truncation test for VGG.

    endchoice
endmenu

# ALEXNET_TEST菜单
menu "ALEXNET_TEST"
    visible if TYPE_ALEXNET
    
    choice
        prompt "Select operation type"
        default ALEXNET_INT8
        help
            Select one of the AlexNet operations for the test.

    config ALEXNET_INT8
        bool "alexnet_int8_test"

        help
            Enable Posit32 to Int8 truncation test for AlexNet.

    config ALEXNET_INT4
        bool "alexnet_int4_test"

        help
            Enable Posit32 to Int4 truncation test for AlexNet.
    
    config ALEXNET_FP16
        bool "alexnet_fp16_test"

        help
            Enable Posit32 to FP16 truncation test for AlexNet.

    config ALEXNET_FP8
        bool "alexnet_fp8_test"

        help
            Enable Posit32 to FP8 truncation test for AlexNet.
            
    config ALEXNET_FP4
        bool "alexnet_fp4_test"

        help
            Enable Posit32 to FP4 truncation test for AlexNet.

    endchoice
endmenu

# LENET_TEST菜单
menu "LENET_TEST"
    visible if TYPE_LENET
    
    choice
        prompt "Select operation type"
        default LENET_INT8
        help
            Select one of the LeNet operations for the test.

    config LENET_INT8
        bool "lenet_int8_test"

        help
            Enable Posit32 to Int8 truncation test for LeNet.

    config LENET_INT4
        bool "lenet_int4_test"

        help
            Enable Posit32 to Int4 truncation test for LeNet.

    config LENET_FP16
        bool "lenet_fp16_test"

        help
            Enable Posit32 to FP16 truncation test for LeNet.
            
    config LENET_FP8
        bool "lenet_fp8_test"

        help
            Enable Posit32 to FP8 truncation test for LeNet.
            
    config LENET_FP4
        bool "lenet_fp4_test"

        help
            Enable Posit32 to FP4 truncation test for LeNet.

    endchoice
endmenu

# MOBILENET_TEST菜单
menu "MOBILENET_TEST"
    visible if TYPE_MOBILENET
    
    choice
        prompt "Select operation type"
        default MOBILENET_INT8
        help
            Select one of the MobileNet operations for the test.

    config MOBILENET_INT8
        bool "mobilenet_int8_test"

        help
            Enable Posit32 to Int8 truncation test for MobileNet.

    config MOBILENET_INT4
        bool "mobilenet_int4_test"

        help
            Enable Posit32 to Int4 truncation test for MobileNet.

    config MOBILENET_FP16
        bool "mobilenet_fp16_test"

        help
            Enable Posit32 to FP16 truncation test for MobileNet.
            
    config MOBILENET_FP8
        bool "mobilenet_fp8_test"

        help
            Enable Posit32 to FP8 truncation test for MobileNet.
            
    config MOBILENET_FP4
        bool "mobilenet_fp4_test"

        help
            Enable Posit32 to FP4 truncation test for MobileNet.

    endchoice
endmenu

# SQUEEZENET_TEST菜单
menu "SQUEEZENET_TEST"
    visible if TYPE_SQUEEZENET
    
    choice
        prompt "Select operation type"
        default SQUEEZENET_INT8
        help
            Select one of the SqueezeNet operations for the test.

    config SQUEEZENET_INT8
        bool "squeezenet_int8_test"

        help
            Enable Posit32 to Int8 truncation test for SqueezeNet.

    config SQUEEZENET_INT4
        bool "squeezenet_int4_test"

        help
            Enable Posit32 to Int4 truncation test for SqueezeNet.

    config SQUEEZENET_FP16
        bool "squeezenet_fp16_test"

        help
            Enable Posit32 to FP16 truncation test for SqueezeNet.
            
    config SQUEEZENET_FP8
        bool "squeezenet_fp8_test"

        help
            Enable Posit32 to FP8 truncation test for SqueezeNet.
            
    config SQUEEZENET_FP4
        bool "squeezenet_fp4_test"

        help
            Enable Posit32 to FP4 truncation test for SqueezeNet.

    endchoice
endmenu

# CONVNEXT_TEST菜单
menu "CONVNEXT_TEST"
    visible if TYPE_CONVNEXT
    
    choice
        prompt "Select operation type"
        default CONVNEXT_INT8
        help
            Select one of the ConvNeXt operations for the test.

    config CONVNEXT_INT8
        bool "convnext_int8_test"

        help
            Enable Posit32 to Int8 truncation test for ConvNeXt.

    config CONVNEXT_INT4
        bool "convnext_int4_test"

        help
            Enable Posit32 to Int4 truncation test for ConvNeXt.

    config CONVNEXT_FP16
        bool "convnext_fp16_test"

        help
            Enable Posit32 to FP16 truncation test for ConvNeXt.
            
    config CONVNEXT_FP8
        bool "convnext_fp8_test"

        help
            Enable Posit32 to FP8 truncation test for ConvNeXt.
            
    config CONVNEXT_FP4
        bool "convnext_fp4_test"

        help
            Enable Posit32 to FP4 truncation test for ConvNeXt.

    endchoice
endmenu

# SHUFFLENETV2_TEST菜单
menu "SHUFFLENETV2_TEST"
    visible if TYPE_SHUFFLENETV2
    
    choice
        prompt "Select operation type"
        default SHUFFLENETV2_INT8
        help
            Select one of the ShuffleNetV2 operations for the test.

    config SHUFFLENETV2_INT8
        bool "shufflenetv2_int8_test"

        help
            Enable Posit32 to Int8 truncation test for ShuffleNetV2.

    config SHUFFLENETV2_INT4
        bool "shufflenetv2_int4_test"

        help
            Enable Posit32 to Int4 truncation test for ShuffleNetV2.

    config SHUFFLENETV2_FP16
        bool "shufflenetv2_fp16_test"

        help
            Enable Posit32 to FP16 truncation test for ShuffleNetV2.
            
    config SHUFFLENETV2_FP8
        bool "shufflenetv2_fp8_test"

        help
            Enable Posit32 to FP8 truncation test for ShuffleNetV2.
            
    config SHUFFLENETV2_FP4
        bool "shufflenetv2_fp4_test"

        help
            Enable Posit32 to FP4 truncation test for ShuffleNetV2.

    endchoice
endmenu

# EFFICIENTNET_TEST菜单
menu "EFFICIENTNET_TEST"
    visible if TYPE_EFFICIENTNET
    
    choice
        prompt "Select operation type"
        default EFFICIENTNET_INT8
        help
            Select one of the EfficientNet operations for the test.

    config EFFICIENTNET_INT8
        bool "efficientnet_int8_test"

        help
            Enable Posit32 to Int8 truncation test for EfficientNet.

    config EFFICIENTNET_INT4
        bool "efficientnet_int4_test"

        help
            Enable Posit32 to Int4 truncation test for EfficientNet.

    config EFFICIENTNET_FP16
        bool "efficientnet_fp16_test"

        help
            Enable Posit32 to FP16 truncation test for EfficientNet.
            
    config EFFICIENTNET_FP8
        bool "efficientnet_fp8_test"

        help
            Enable Posit32 to FP8 truncation test for EfficientNet.
            
    config EFFICIENTNET_FP4
        bool "efficientnet_fp4_test"

        help
            Enable Posit32 to FP4 truncation test for EfficientNet.

    endchoice
endmenu

# REGNET_TEST菜单
menu "REGNET_TEST"
    visible if TYPE_REGNET
    
    choice
        prompt "Select operation type"
        default REGNET_INT8
        help
            Select one of the RegNet operations for the test.

    config REGNET_INT8
        bool "regnet_int8_test"

        help
            Enable Posit32 to Int8 truncation test for RegNet.
    
    config REGNET_INT4
        bool "regnet_int4_test"

        help
            Enable Posit32 to Int4 truncation test for RegNet.

    config REGNET_FP16
        bool "regnet_fp16_test"

        help
            Enable Posit32 to FP16 truncation test for RegNet.
            
    config REGNET_FP8
        bool "regnet_fp8_test"

        help
            Enable Posit32 to FP8 truncation test for RegNet.
            
    config REGNET_FP4
        bool "regnet_fp4_test"

        help
            Enable Posit32 to FP4 truncation test for RegNet.

    endchoice
endmenu

# 设置配置辅助变量
config SAMPLE_TEST
    bool
    default y if TYPE_SAMPLE
```
